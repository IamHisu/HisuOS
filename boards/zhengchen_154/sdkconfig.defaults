## boards/zhengchen_154/sdkconfig.defaults
```kconfig
CONFIG_IDF_TARGET="esp32s3"
CONFIG_ESPTOOLPY_FLASHSIZE_16MB=y
CONFIG_ESPTOOLPY_FLASHMODE_DIO=y
CONFIG_ESPTOOLPY_FLASHFREQ_80M=y
CONFIG_SPIRAM=y
CONFIG_SPIRAM_MODE_OCT=y
CONFIG_SPIRAM_SPEED_40M=y
CONFIG_SPIRAM_USE_MALLOC=y
CONFIG_SPIRAM_MALLOC_ALWAYSINTERNAL=16384
CONFIG_SPIRAM_MALLOC_RESERVE_INTERNAL=32768
CONFIG_FREERTOS_TASK_CREATE_ALLOW_EXT_MEM=y
# GPIO20 is the LCD backlight; native USB Serial/JTAG also uses GPIO19/20.
CONFIG_ESP_CONSOLE_UART_DEFAULT=y
CONFIG_ESP_CONSOLE_SECONDARY_NONE=y
# CONFIG_USJ_ENABLE_USB_SERIAL_JTAG is not set
```

## components/hisu_ui/Kconfig
```kconfig
menu "HisuOS UI"
    config HISU_BLE_COMPANION_URL
        string "HTTPS URL of the BLE companion page"
        default "https://iamhisu.github.io/HisuOS/ble/"
        help
            Publish the companion website before using the QR code.
            Publish main /docs with GitHub Pages to serve docs/ble at /ble/.
endmenu
```

## components/hisu_voice/Kconfig.projbuild
```kconfig
menu "Hi Su voice"
    config HISU_MEMORY_SUMMARY_MODEL
        string "Gemini text model for post-session memory extraction"
        default "gemini-3.5-flash-lite"
        help
            Uses only the primary Chat key while idle, online and externally
            powered or battery >=20%. No model/key fallback. Requires quota.
    config HISU_VOICE_TTS_MODEL
        string "Gemini model for online reminder speech"
        default "gemini-2.5-flash-preview-tts"
        help
            TTS model identifier only, not a URL. Offline reminder audio is used
            when online synthesis fails. No automatic model fallback.
endmenu
```
